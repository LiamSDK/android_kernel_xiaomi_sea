// SPDX-License-Identifier: GPL-2.0-only
/* Redmi Note 12S (sea / mt6781) Focaltech FT3418 I2C0 & Xiaomi Touch bindings for Kernel 6.6 */

&i2c0 {
    clock-frequency = <0x61a80>;
    pinctrl-names = "default", "ts_int_active", "ts_reset_active", "ts_int_suspend", "ts_reset_suspend", "ts_i2c_mode", "ts_eint_high";
    pinctrl-0 = <&ctp_pins_default>;
    pinctrl-1 = <&ctp_ts_int_active>;
    pinctrl-2 = <&ctp_ts_reset_active>;
    pinctrl-3 = <&ctp_ts_int_suspend>;
    pinctrl-4 = <&ctp_ts_reset_suspend>;
    pinctrl-5 = <&ctp_ts_i2c_mode>;
    pinctrl-6 = <&ctp_ts_int_as_gpio>;
    touch@0 {
        compatible = "focaltech,fts";
        reg = <0x38>;
        status = "okay";
        interrupt-parent = <&pio>;
        focaltech,reset-gpio = <&pio 0x10 0x0>;
        focaltech,irq-gpio = <&pio 0xf 0x0>;
        focaltech,avdd-gpio = <&pio 0x3a 0x0>;
        focaltech,max-touch-number = <0xa>;
        focaltech,display-coords = <0x0 0x0 0x437 0x95f>;
        tpd-filter-enable = <0x0>;
        tpd-filter-pixel-density = <0xa1>;
        tpd-filter-custom-prameters = <0x0 0x0 0x0 0x0 0x0 0x0 0x0 0x0 0x0 0x0 0x0 0x0>;
        tpd-filter-custom-speed = <0x0 0x0 0x0>;
    };
};

&xiaomi_touch {
    status = "ok";
    compatible = "xiaomi-touch";
    touch,name = "xiaomi-touch";
};
