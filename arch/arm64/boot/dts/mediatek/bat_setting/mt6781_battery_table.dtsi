// SPDX-License-Identifier: GPL-2.0-only
/* Redmi Note 12S (sea / mt6781) MT6358 Fuel Gauge ZCV/OCV Multi-Battery Profile Tables for Kernel 6.6 */

&mtk_gauge {
    DIFFERENCE_FULLOCV_ITH = <0xfa>;
    SHUTDOWN_1_TIME = <0x1e>;
    KEEP_100_PERCENT = <0x1>;
    R_FG_VALUE = <0x5>;
    EMBEDDED_SEL = <0x1>;
    PMIC_SHUTDOWN_CURRENT = <0x14>;
    FG_METER_RESISTANCE = <0x64>;
    CAR_TUNE_VALUE = <0x64>;
    PMIC_MIN_VOL = <0x82dc>;
    POWERON_SYSTEM_IBOOT = <0x1f4>;
    SHUTDOWN_GAUGE0_VOLTAGE = <0x84d0>;
    TEMPERATURE_T0 = <0x32>;
    TEMPERATURE_T1 = <0x19>;
    TEMPERATURE_T2 = <0xa>;
    TEMPERATURE_T3 = <0x0>;
    TEMPERATURE_T4 = <0xfffffff6>;
    g_FG_PSEUDO100_T0 = <0x61>;
    g_FG_PSEUDO100_T1 = <0x61>;
    g_FG_PSEUDO100_T2 = <0x61>;
    g_FG_PSEUDO100_T3 = <0x5a>;
    g_FG_PSEUDO100_T4 = <0x56>;
    Q_MAX_SYS_VOLTAGE_BAT0 = <0xd16>;
    Q_MAX_SYS_VOLTAGE_BAT1 = <0xd16>;
    Q_MAX_SYS_VOLTAGE_BAT2 = <0xd16>;
    Q_MAX_SYS_VOLTAGE_BAT3 = <0xd16>;
    COM_FG_METER_RESISTANCE = <0x64>;
    COM_R_FG_VALUE = <0x5>;
    enable_tmp_intr_suspend = <0x0>;
    ACTIVE_TABLE = <0x0>;
    MULTI_TEMP_GAUGE0 = <0x1>;
    g_PMIC_MIN_VOL_row = <0x4>;
    g_PMIC_MIN_VOL_col = <0xa>;
    g_PMIC_MIN_VOL = <0x82dc 0x82dc 0x82dc 0x82dc 0x80e8 0x80e8 0x80e8 0x80e8 0x82dc 0x82dc 0x8462 0x82dc 0x7dc8 0x7dc8 0x82dc 0x7dc8 0x7918 0x7918 0x82dc 0x7918 0x7b0c 0x7b0c 0x7b0c 0x7b0c 0x7918 0x7918 0x7918 0x7918 0x7918 0x7918 0x7918 0x7918 0x7918 0x7918 0x7918 0x7918 0x7918 0x7918 0x7918 0x79e0>;
    g_PON_SYS_IBOOT_row = <0x4>;
    g_PON_SYS_IBOOT_col = <0xa>;
    g_PON_SYS_IBOOT = <0x1388 0x1388 0x1388 0x1388 0x1388 0x1388 0x1388 0x1388 0x1388 0x1388 0x1388 0x1388 0x1388 0x1388 0x1388 0x1388 0x1388 0x1388 0x1388 0x1388 0x1388 0x1388 0x1388 0x1388 0x1388 0x1388 0x1388 0x1388 0x1388 0x1388 0x1388 0x1388 0x1388 0x1388 0x1388 0x1388 0x1388 0x1388 0x1388 0x1388>;
    g_QMAX_SYS_VOL_row = <0x4>;
    g_QMAX_SYS_VOL_col = <0xa>;
    g_QMAX_SYS_VOL = <0x8886 0x8886 0x8886 0x8886 0x8886 0x8886 0x8886 0x8886 0x8886 0x8886 0x8886 0x85ca 0x7ef4 0x8886 0x8886 0x85ca 0x7918 0x8822 0x8822 0x85ca 0x7ef4 0x7ef4 0x7ef4 0x7ef4 0x8020 0x8020 0x8020 0x8020 0x8020 0x8020 0x8020 0x8020 0x8020 0x8020 0x8020 0x8020 0x8020 0x8020 0x8020 0x8020>;
    g_FG_PSEUDO100_row = <0x4>;
    g_FG_PSEUDO100_col = <0xa>;
    g_FG_PSEUDO100 = <0x5e 0x5e 0x5e 0x64 0x5e 0x5e 0x5e 0x64 0x5e 0x5e 0x5e 0x64 0x5b 0x56 0x5e 0x64 0x57 0x50 0x5a 0x64 0x64 0x64 0x61 0x64 0x64 0x64 0x61 0x64 0x64 0x64 0x61 0x64 0x64 0x64 0x61 0x64 0x64 0x64 0x61 0x64>;
};
