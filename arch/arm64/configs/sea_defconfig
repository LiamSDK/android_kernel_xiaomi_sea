## drivers/interconnect/mediatek/Kconfig
```kconfig
# SPDX-License-Identifier: GPL-2.0-only
config INTERCONNECT_MEDIATEK
	tristate "MediaTek interconnect drivers"
	depends on ARCH_MEDIATEK || COMPILE_TEST
	help
	  Support for MediaTek On-Chip Interconnect bus drivers.

config INTERCONNECT_MTK_EMI
	tristate "MediaTek EMI interconnect driver"
	depends on INTERCONNECT_MEDIATEK
	help
	  This driver provides support for the MediaTek EMI interconnect
	  provider which manages DDR bandwidth votes and communicates
	  with the DVFSRC hardware.

config INTERCONNECT_MTK_MMQOS_COMMON
	tristate "MediaTek MMQoS Common Driver"
	depends on INTERCONNECT_MEDIATEK
	help
	  Common support for MediaTek Multimedia Quality of Service (MMQoS)
	  interconnect provider and bandwidth throttling.

config INTERCONNECT_MTK_MMQOS_MT6781
	tristate "MediaTek MT6781 MMQoS interconnect driver"
	depends on INTERCONNECT_MTK_MMQOS_COMMON
	help
	  This driver provides support for the MediaTek MT6781 MMQoS interconnect
	  provider managing LARBs and multimedia bandwidth.
```

## drivers/memory/mediatek/Kconfig
```kconfig
config MTK_DRAMC
	tristate "MediaTek DRAMC driver"
	default m
	help
	  This selects the MediaTek DRAMC driver.
	  Provide the API for DRAMC low power scenario, and the interface
	  for reporting DRAM information, e.g. DRAM mode register (MR) for
	  DRAM vendor ID, temperature, and density.
```

## drivers/misc/mediatek/Kconfig
```kconfig
# SPDX-License-Identifier: GPL-2.0

menu "MediaTek Proprietary and Platform Drivers"

config MTK_PLATFORM
	string "MTK platform name"
	default "mt6781"

config ARCH_MTK_PROJECT
	string "MTK project name"
	default "sea"

source "drivers/misc/mediatek/flashlight/Kconfig"
source "drivers/misc/mediatek/imgsensor/Kconfig"
source "drivers/misc/mediatek/cam_cal/Kconfig"
source "drivers/misc/mediatek/cameraisp/Kconfig"
source "drivers/misc/mediatek/connectivity/Kconfig"
source "drivers/misc/mediatek/ccci_util/Kconfig"
source "drivers/misc/mediatek/eccci/Kconfig"
source "drivers/misc/mediatek/sensors-1.0/Kconfig"
source "drivers/misc/mediatek/audio_ipi/Kconfig"
source "drivers/misc/mediatek/elliptic/Kconfig"
source "drivers/misc/mediatek/power_throttling/Kconfig"

endmenu
```

## drivers/misc/mediatek/power_throttling/Kconfig
```kconfig
# SPDX-License-Identifier: GPL-2.0

config MTK_POWER_THROTTLING_COMMON
	bool "MediaTek power throttling common interface"
	default y

config PMIC_LBAT_SERVICE
	tristate "PMIC lbat service"
	select MTK_POWER_THROTTLING_COMMON
	default m
	help
	  For MediaTek PMIC lbat service.

config MTK_LOW_BATTERY_POWER_THROTTLING
	tristate "MTK low battery throttle"
	select MTK_POWER_THROTTLING_COMMON
	select PMIC_LBAT_SERVICE
	default m
	help
	  For MediaTek low battery power throttling.

config MTK_BATTERY_OC_POWER_THROTTLING
	tristate "MTK battery over current throttle"
	select MTK_POWER_THROTTLING_COMMON
	default m
	help
	  For MediaTek battery over current power throttling.

config MTK_BATTERY_PERCENTAGE_POWER_THROTTLING
	tristate "MTK battery percentage throttle"
	select MTK_POWER_THROTTLING_COMMON
	default m
	help
	  For MediaTek battery percentage power throttling.

config MTK_DYNAMIC_LOADING_POWER_THROTTLING
	tristate "MTK dynamic loading throttle"
	select MTK_POWER_THROTTLING_COMMON
	default m
	help
	  For MediaTek dynamic loading power throttling.
```
